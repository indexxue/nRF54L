## CMakeLists.txt
```
# SPDX-License-Identifier: Apache-2.0

cmake_minimum_required(VERSION 3.20.0)

# Zigbee R23 add-on (ncs-zigbee). Set NCS_ZIGBEE_ROOT in nrf.env.
if(DEFINED ENV{NCS_ZIGBEE_ROOT} AND EXISTS "$ENV{NCS_ZIGBEE_ROOT}/zephyr/module.yml")
  list(APPEND EXTRA_ZEPHYR_MODULES "$ENV{NCS_ZIGBEE_ROOT}")
else()
  message(FATAL_ERROR
    "NCS_ZIGBEE_ROOT missing or invalid. Clone Zigbee R23 add-on, e.g.:\n"
    "  git clone --branch v1.4.0 https://github.com/nrfconnect/ncs-zigbee.git D:/ncs/tmp/ncs-zigbee\n"
    "  then set NCS_ZIGBEE_ROOT=D:/ncs/tmp/ncs-zigbee in nrf.env\n"
    "NOTE: add-on v1.4.0 targets NCS v3.4.x; this repo default is NCS v3.2.0 ? see README.")
endif()

list(APPEND EXTRA_ZEPHYR_MODULES
  ${CMAKE_CURRENT_SOURCE_DIR}/../../modules/nrf54_common
  ${CMAKE_CURRENT_SOURCE_DIR}/../../modules/nrf54_start
)

set(DTC_OVERLAY_FILE ${CMAKE_CURRENT_SOURCE_DIR}/board/app.overlay)

find_package(Zephyr REQUIRED HINTS $ENV{ZEPHYR_BASE})
project(zigbee_demo)

target_sources(app PRIVATE
  src/app.c
  board/board_config.c
  lib/zigbee/zigbee_app.c
  lib/zigbee/zboss_mem_globals.c
)

# LTO prebuilt ZBOSS: keep mem globals on classic ELF path (Nordic sample pattern).
set_source_files_properties(lib/zigbee/zboss_mem_globals.c PROPERTIES COMPILE_OPTIONS -fno-lto)

target_include_directories(app PRIVATE
  src
  lib/zigbee
)
```

## prj.conf
```kconfig
# zigbee_demo — Zigbee ED + UART/LED/BTN（eink_tag rev_b 脚；无 BLE/EPD）
# Zigbee R23 add-on via NCS_ZIGBEE_ROOT；扫描掩码对齐 ZigBridge-EM M5

CONFIG_PRINTK=y
CONFIG_CONSOLE=y
CONFIG_UART_CONSOLE=y
CONFIG_SERIAL=y
CONFIG_UART_INTERRUPT_DRIVEN=y
CONFIG_REBOOT=y
CONFIG_GPIO=y

# 诊断：UART 无输出时用 J-Link RTT Viewer 看日志（与 UART console 可并存）
CONFIG_USE_SEGGER_RTT=y
CONFIG_RTT_CONSOLE=y

# Keep Zephyr LOG off so common/log.c log_init does not clash with log_core.c.
# Zigbee app_utils LOG_* become no-ops; app status uses common/log.h + printk.
CONFIG_LOG=n

CONFIG_CLOCK_CONTROL_NRF_K32SRC_RC=y
# Zigbee 启用 MPSL/802.15.4 后 HFCLK 由 MPSL 管；再手动 START_REQUEST_HFXO
# 会在 onoff_request 里与 MPSL 死等（PC 卡在 MPSL clock wait，无串口/无灯）。
# 联调勿开；与官方 light_bulb/template 一致，不额外要 HFXO。
CONFIG_START_REQUEST_HFXO=n

CONFIG_HEAP_MEM_POOL_SIZE=2048
CONFIG_SYSTEM_WORKQUEUE_STACK_SIZE=2048
CONFIG_MAIN_STACK_SIZE=4096

CONFIG_FLASH=y
CONFIG_FLASH_MAP=y
CONFIG_MPU_ALLOW_FLASH_WRITE=y

# 保留 common NVS/Settings（storage_partition）；ZBOSS 另用 zboss-nvram
CONFIG_NVS=y
CONFIG_SETTINGS=y
CONFIG_SETTINGS_NVS=y

CONFIG_APP_VERSION_STRING="0.0.0"
CONFIG_NRF54_NVS_DEFAULT_DEVICE_ID=0x53530130

# --- Zigbee End Device ---
CONFIG_ZIGBEE_ADD_ON=y
CONFIG_ZIGBEE_APP_UTILS=y
CONFIG_ZIGBEE_ROLE_END_DEVICE=y
# Multi-channel scan: must cover gateway ZNP_CHANNEL_MASK_DEFAULT (11/15/20/25)
CONFIG_ZIGBEE_CHANNEL_SELECTION_MODE_MULTI=y
CONFIG_ZIGBEE_CHANNEL_MASK=0x02108800

# ncs-zigbee v1.4 LTO prebuilts need GCC 14 (NCS 3.4). On NCS 3.2/GCC12 use
# trace (non-LTO) libs so link can succeed for ED bring-up.
CONFIG_ZIGBEE_ENABLE_TRACES=y
CONFIG_LTO=n

# No DK button lib; leave via app button + zb_bdb_reset_via_local_action
CONFIG_DK_LIBRARY=n
CONFIG_ZIGBEE_FACTORY_RESET=n
```

## src/app.c
```c
/*
 * zigbee_demo — LED/按键 + Zigbee ED + OnOff Server；无 BLE/EPD。
 *
 * BTN1 短按 → 60s 配网窗 + Steering；BTN2 双击 → leave 清网并停住（不自动搜网）。
 * 网关 znp light → EP1 OnOff → 板载绿灯 + light: on|off
 */

#include "start.h"
#include "zigbee_app.h"

#include <zephyr/kernel.h>
#include <zephyr/sys/printk.h>

#include "board.h"
#include "button.h"
#include "device_profile.h"
#include "event.h"
#include "led_scene.h"
#include "log.h"
#include "nvs.h"

static zigbee_app_state_t s_zb_state = ZIGBEE_APP_STATE_IDLE;
static bool s_light_on;

static void app_zb_led_cancel_all(void)
{
	led_scene_cancel(LED_SCENE_ID_PAIRING);
	led_scene_cancel(LED_SCENE_ID_SUCCESS);
	led_scene_cancel(LED_SCENE_ID_ERROR);
	led_scene_cancel(LED_SCENE_ID_TRIGGER);
}

static void app_zb_led_apply(zigbee_app_state_t st)
{
	app_zb_led_cancel_all();

	switch (st) {
	case ZIGBEE_APP_STATE_STEERING:
		led_scene_run(LED_SCENE_ID_PAIRING);
		break;
	case ZIGBEE_APP_STATE_JOINED:
		led_scene_run(LED_SCENE_ID_SUCCESS);
		break;
	case ZIGBEE_APP_STATE_FAILED:
		led_scene_run(LED_SCENE_ID_ERROR);
		break;
	case ZIGBEE_APP_STATE_IDLE:
	default:
		led_scene_run(LED_SCENE_ID_TRIGGER);
		break;
	}
}

static void app_light_apply(bool on)
{
	s_light_on = on;
	app_zb_led_cancel_all();
	/* 控灯用绿灯（LED0）；灭时两灯都关 */
	led_scene_led_direct_set(LED_SCENE_LED_0, on);
	led_scene_led_direct_set(LED_SCENE_LED_1, false);
	LOG_INFO("light: %s", on ? "on" : "off");
	printk("light: %s\n", on ? "on" : "off");
}

static void app_zb_log_net(const zigbee_app_evt_t *evt)
{
	switch (evt->state) {
	case ZIGBEE_APP_STATE_STEERING:
		LOG_INFO("zigbee: steering");
		printk("zigbee: steering (mask=0x%08x ep=%d)\n",
		       CONFIG_ZIGBEE_CHANNEL_MASK, ZIGBEE_APP_ENDPOINT);
		break;
	case ZIGBEE_APP_STATE_JOINED:
		if (evt->ieee_valid) {
			LOG_INFO(
				"zigbee: joined nwk=0x%04x ieee=%02X%02X%02X%02X%02X%02X%02X%02X",
				evt->nwk_addr, evt->ieee[7], evt->ieee[6], evt->ieee[5],
				evt->ieee[4], evt->ieee[3], evt->ieee[2], evt->ieee[1],
				evt->ieee[0]);
			printk("zigbee: joined nwk=0x%04x ieee=%02X%02X%02X%02X%02X%02X%02X%02X\n",
			       evt->nwk_addr, evt->ieee[7], evt->ieee[6], evt->ieee[5],
			       evt->ieee[4], evt->ieee[3], evt->ieee[2], evt->ieee[1],
			       evt->ieee[0]);
		} else {
			LOG_INFO("zigbee: joined");
			printk("zigbee: joined\n");
		}
		break;
	case ZIGBEE_APP_STATE_FAILED:
		LOG_INFO("zigbee: failed");
		printk("zigbee: failed\n");
		break;
	case ZIGBEE_APP_STATE_IDLE:
	default:
		LOG_INFO("zigbee: idle / left");
		printk("zigbee: idle / left\n");
		break;
	}
}

static void app_handle_zigbee_evt(void)
{
	zigbee_app_evt_t evt;

	while (zigbee_app_evt_fetch(&evt)) {
		if (evt.kind == ZIGBEE_APP_EVT_LIGHT) {
			app_light_apply(evt.light_on);
			continue;
		}

		s_zb_state = evt.state;
		app_zb_log_net(&evt);
		app_zb_led_apply(evt.state);
		if (evt.state == ZIGBEE_APP_STATE_IDLE) {
			s_light_on = false;
		}
	}
}

static void app_handle_button(void)
{
	btn_id_e id;
	btn_event_e ev;

	if (!event_is_set(EVT_ID_BUTTON)) {
		return;
	}

	button_last_event_get(&id, &ev);
	event_clear(EVT_ID_BUTTON);
	button_last_event_clear();

	if ((id == BTN_ID_CONFIRM) && (ev == BTN_EVENT_SINGLE_CLICK)) {
		LOG_INFO("app: BTN1 short -> steer");
		zigbee_app_steer_request();
		return;
	}

	if ((id == BTN_ID_BACK) && (ev == BTN_EVENT_DOUBLE_CLICK)) {
		LOG_INFO("app: BTN2 double -> leave");
		s_zb_state = ZIGBEE_APP_STATE_IDLE;
		s_light_on = false;
		app_zb_led_apply(ZIGBEE_APP_STATE_IDLE);
		zigbee_app_leave_request();
	}
}

status_t app_init(void)
{
	uint8_t bmode = nvs_boot_mode_get();
	status_t st;

	/* 尽早打串口，便于确认已越过 start_boot / HFXO */
	printk("zigbee_demo boot\n");

	LOG_INFO("zigbee_demo app_init hw=%s bmode=%u mask=0x%08x ep=%d",
		 device_profile_hardware_name(device_profile_hardware_id()), (unsigned)bmode,
		 CONFIG_ZIGBEE_CHANNEL_MASK, ZIGBEE_APP_ENDPOINT);
	printk("zigbee_demo printk ok mask=0x%08x ep=%d (BTN1=steer BTN2-dbl=leave OnOff)\n",
	       CONFIG_ZIGBEE_CHANNEL_MASK, ZIGBEE_APP_ENDPOINT);

	st = zigbee_app_start();
	if (st != STATUS_OK) {
		LOG_ERROR("zigbee_app_start failed st=%d", (int)st);
		return st;
	}

	s_light_on = false;
	app_zb_led_apply(ZIGBEE_APP_STATE_IDLE);
	return STATUS_OK;
}

void app_run(void)
{
	LOG_INFO("zigbee_demo run (start_poll 20ms)");
	(void)s_zb_state;
	(void)s_light_on;

	while (1) {
		start_poll();
		app_handle_button();
		app_handle_zigbee_evt();
		k_sleep(K_MSEC(20));
	}
}
```

## src/zb_mem_config_custom.h
```c
/*
 * Copyright (c) 2024 Nordic Semiconductor ASA
 *
 * SPDX-License-Identifier: LicenseRef-Nordic-5-Clause
 */

#ifndef ZB_MEM_CONFIG_CUSTOM_H
#define ZB_MEM_CONFIG_CUSTOM_H 1


#define ZB_CONFIG_ROLE_ZED
#define ZB_CONFIG_OVERALL_NETWORK_SIZE 16

/**
 * Light routing and application traffic from/to that device.
 */
#define ZB_CONFIG_LIGHT_TRAFFIC

/**
 * Simple user's application at that device: not too many relations
 * to other devices.
 */
#define ZB_CONFIG_APPLICATION_SIMPLE

/**
 * The below section is for advanced users.
 * Before modifying any values, please make sure you fully understand the
 * impact, for example by reading zb_mem_config_common.h
 */
#include "zb_mem_config_common.h"

/**
 * Now if you REALLY know what you do, you can study zb_mem_config_common.h
 * and redefine some configuration parameters, like:
 */
#undef ZB_CONFIG_SCHEDULER_Q_SIZE
#define ZB_CONFIG_SCHEDULER_Q_SIZE 24

/**
 * Increase OTA transfer time by extending the APS duplicate rejection table.
 * This value must be less than the amount of possible APS counter values (256).
 */
#undef ZB_CONFIG_APS_DUPS_TABLE_SIZE
#define ZB_CONFIG_APS_DUPS_TABLE_SIZE 64

/* Memory context definitions. */
#include "zb_mem_config_context.h"

#endif /* ZB_MEM_CONFIG_CUSTOM_H */
```

## src/zigbee_app.c
```c
/**
 * @file zigbee_app.c
 * @brief Zigbee ED 薄封装：Basic+Identify 最小端点；回调只入队。
 *
 * 注意：本文件使用 Zephyr LOG，勿 include common/log.h。
 */

#include "zigbee_app.h"

#include <string.h>

#include <zephyr/kernel.h>
#include <zephyr/logging/log.h>

#include <zboss_api.h>
#include <zb_nrf_platform.h>
#include <zigbee/zigbee_app_utils.h>
#include <zigbee/zigbee_error_handler.h>

#include "zb_range_extender.h"

LOG_MODULE_REGISTER(zigbee_app, LOG_LEVEL_INF);

#define APP_ZIGBEE_ENDPOINT 10
#define TEMPLATE_INIT_BASIC_POWER_SOURCE ZB_ZCL_BASIC_POWER_SOURCE_DC_SOURCE

struct zb_device_ctx {
	zb_zcl_basic_attrs_t basic_attr;
	zb_zcl_identify_attrs_t identify_attr;
};

static struct zb_device_ctx s_dev_ctx;

ZB_ZCL_DECLARE_IDENTIFY_ATTRIB_LIST(identify_attr_list, &s_dev_ctx.identify_attr.identify_time);

ZB_ZCL_DECLARE_BASIC_ATTRIB_LIST(basic_attr_list, &s_dev_ctx.basic_attr.zcl_version,
				 &s_dev_ctx.basic_attr.power_source);

ZB_DECLARE_RANGE_EXTENDER_CLUSTER_LIST(app_template_clusters, basic_attr_list, identify_attr_list);

ZB_DECLARE_RANGE_EXTENDER_EP(app_template_ep, APP_ZIGBEE_ENDPOINT, app_template_clusters);

ZBOSS_DECLARE_DEVICE_CTX_1_EP(app_template_ctx, app_template_ep);

K_MSGQ_DEFINE(s_zb_evt_q, sizeof(zigbee_app_evt_t), 8, 4);

static void zigbee_app_evt_post(zigbee_app_state_t state, bool with_addr)
{
	zigbee_app_evt_t evt = {
		.state = state,
		.nwk_addr = 0U,
		.ieee_valid = false,
	};

	if (with_addr && ZB_JOINED()) {
		zb_ieee_addr_t ieee;

		evt.nwk_addr = zb_get_short_address();
		zb_get_long_address(ieee);
		memcpy(evt.ieee, ieee, sizeof(evt.ieee));
		evt.ieee_valid = true;
	}

	if (k_msgq_put(&s_zb_evt_q, &evt, K_NO_WAIT) != 0) {
		LOG_WRN("zigbee evt queue full, drop state=%d", (int)state);
	}
}

static void zigbee_app_clusters_attr_init(void)
{
	s_dev_ctx.basic_attr.zcl_version = ZB_ZCL_VERSION;
	s_dev_ctx.basic_attr.power_source = TEMPLATE_INIT_BASIC_POWER_SOURCE;
	s_dev_ctx.identify_attr.identify_time = ZB_ZCL_IDENTIFY_IDENTIFY_TIME_DEFAULT_VALUE;
}

static void zigbee_app_do_leave(zb_bufid_t bufid)
{
	ZVUNUSED(bufid);
	LOG_INF("zigbee: leave / factory reset network");
	zb_bdb_reset_via_local_action(0);
}

status_t zigbee_app_start(void)
{
	LOG_INF("zigbee: start ED channel=%d", CONFIG_ZIGBEE_CHANNEL);

	ZB_AF_REGISTER_DEVICE_CTX(&app_template_ctx);
	zigbee_app_clusters_attr_init();
	zigbee_enable();
	zigbee_app_evt_post(ZIGBEE_APP_STATE_IDLE, false);
	return STATUS_OK;
}

void zigbee_app_steer_request(void)
{
	LOG_INF("zigbee: steer request (user_input_indicate)");
	zigbee_app_evt_post(ZIGBEE_APP_STATE_STEERING, false);
	user_input_indicate();
}

void zigbee_app_leave_request(void)
{
	ZB_SCHEDULE_APP_CALLBACK(zigbee_app_do_leave, 0);
}

bool zigbee_app_evt_fetch(zigbee_app_evt_t *out)
{
	if (out == NULL) {
		return false;
	}
	return k_msgq_get(&s_zb_evt_q, out, K_NO_WAIT) == 0;
}

void zboss_signal_handler(zb_bufid_t bufid)
{
	zb_zdo_app_signal_hdr_t *sig_hnd = NULL;
	zb_zdo_app_signal_type_t sig = zb_get_app_signal(bufid, &sig_hnd);
	zb_ret_t status = ZB_GET_APP_SIGNAL_STATUS(bufid);

	switch (sig) {
	case ZB_BDB_SIGNAL_DEVICE_FIRST_START:
	case ZB_BDB_SIGNAL_DEVICE_REBOOT:
		if (status == RET_OK && ZB_JOINED()) {
			zigbee_app_evt_post(ZIGBEE_APP_STATE_JOINED, true);
		} else if (status != RET_OK) {
			zigbee_app_evt_post(ZIGBEE_APP_STATE_FAILED, false);
		}
		break;

	case ZB_BDB_SIGNAL_STEERING:
		if (status == RET_OK && ZB_JOINED()) {
			zigbee_app_evt_post(ZIGBEE_APP_STATE_JOINED, true);
		} else {
			zigbee_app_evt_post(ZIGBEE_APP_STATE_FAILED, false);
		}
		break;

	case ZB_ZDO_SIGNAL_LEAVE:
		zigbee_app_evt_post(ZIGBEE_APP_STATE_IDLE, false);
		break;

	default:
		break;
	}

	ZB_ERROR_CHECK(zigbee_default_signal_handler(bufid));

	if (bufid) {
		zb_buf_free(bufid);
	}
}
```

## src/zigbee_app.h
```c
/**
 * @file zigbee_app.h
 * @brief Zigbee ED：起栈 / 搜网 / leave；状态入队供 app 消费。
 */

#ifndef ZIGBEE_DEMO_ZIGBEE_APP_H
#define ZIGBEE_DEMO_ZIGBEE_APP_H

#include <stdbool.h>
#include <stdint.h>

#include "type.h"

#ifdef __cplusplus
extern "C" {
#endif

typedef enum {
	ZIGBEE_APP_STATE_IDLE = 0,
	ZIGBEE_APP_STATE_STEERING,
	ZIGBEE_APP_STATE_JOINED,
	ZIGBEE_APP_STATE_FAILED,
} zigbee_app_state_t;

typedef struct {
	zigbee_app_state_t state;
	uint16_t nwk_addr;
	uint8_t ieee[8];
	bool ieee_valid;
} zigbee_app_evt_t;

status_t zigbee_app_start(void);
void zigbee_app_steer_request(void);
void zigbee_app_leave_request(void);

/** 非阻塞取事件；无事件返回 false。 */
bool zigbee_app_evt_fetch(zigbee_app_evt_t *out);

#ifdef __cplusplus
}
#endif

#endif /* ZIGBEE_DEMO_ZIGBEE_APP_H */
```
