## CMakeLists.txt
```
# SPDX-License-Identifier: Apache-2.0
#
# FLPR (RISC-V) remote image — no start/ / common/; tiny standalone Zephyr app.

cmake_minimum_required(VERSION 3.20.0)
find_package(Zephyr REQUIRED HINTS $ENV{ZEPHYR_BASE})
project(remote)

target_sources(app PRIVATE src/main.c)
```

## prj.conf
```kconfig
# FLPR (RISC-V) remote — minimal console on uart30 (board default).
CONFIG_PRINTK=y
CONFIG_CONSOLE=y
CONFIG_UART_CONSOLE=y
CONFIG_SERIAL=y

# nordic-flpr boots this image into SRAM (CONFIG_XIP=n is board defconfig).
CONFIG_GPIO=n
CONFIG_LOG=n
```

## src/main.c
```c
/*
 * demo remote — runs on nRF54L15 FLPR (RISC-V VPR), not on Cortex-M33.
 *
 * Boot path: cpuapp loads this image from RRAM @ 0x165000 into SRAM and
 * starts the FLPR core (nordic-flpr snippet / cpuflpr_vpr).
 *
 * Console: uart30 (DK / SoC default for cpuflpr). App console stays uart20.
 */

#include <zephyr/kernel.h>
#include <zephyr/sys/printk.h>

int main(void)
{
	uint32_t tick = 0U;

	printk("FLPR (RISC-V) up on %s\n", CONFIG_BOARD_TARGET);

	while (1) {
		printk("FLPR heartbeat tick=%u\n", tick);
		tick++;
		k_sleep(K_MSEC(2000));
	}

	return 0;
}
```
