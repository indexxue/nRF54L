## CMakeLists.txt
```
# SPDX-License-Identifier: Apache-2.0

cmake_minimum_required(VERSION 3.20.0)

# Zigbee R23 add-on (ncs-zigbee). Set NCS_ZIGBEE_ROOT in nrf.env.
if(DEFINED ENV{NCS_ZIGBEE_ROOT} AND EXISTS "$ENV{NCS_ZIGBEE_ROOT}/zephyr/module.yml")
  list(APPEND EXTRA_ZEPHYR_MODULES "$ENV{NCS_ZIGBEE_ROOT}")
else()
  message(FATAL_ERROR
    "NCS_ZIGBEE_ROOT missing or invalid. Set NCS_ZIGBEE_ROOT in nrf.env (see zigbee_ed).")
endif()

list(APPEND EXTRA_ZEPHYR_MODULES
  ${CMAKE_CURRENT_SOURCE_DIR}/../../modules/nrf54_common
  ${CMAKE_CURRENT_SOURCE_DIR}/../../modules/nrf54_start
)

# Per-project pinmux; before find_package(Zephyr)
set(DTC_OVERLAY_FILE ${CMAKE_CURRENT_SOURCE_DIR}/board/app.overlay)

find_package(Zephyr REQUIRED HINTS $ENV{ZEPHYR_BASE})
project(factory)

target_sources(app PRIVATE
  src/app.c
  board/board_config.c
  lib/cmd/cmd.c
  lib/zigbee/zbft.c
  lib/zigbee/zboss_mem_globals.c
)

set_source_files_properties(lib/zigbee/zboss_mem_globals.c PROPERTIES COMPILE_OPTIONS -fno-lto)

target_include_directories(app PRIVATE
  src
  lib/cmd
  lib/zigbee
  # Factory sniffing: poke ZBOSS NIB for fixed/dump NWK key (zb_nwk_nib.h).
  $ENV{NCS_ZIGBEE_ROOT}/lib/zboss/src/include
)
```

## sysbuild.conf
```
# MCUBoot + unsigned images for development (see bootloader/README.md).
# Direct XIP: also build secondary-linked variant for slot1 (factory flash).
SB_CONFIG_BOOTLOADER_MCUBOOT=y
SB_CONFIG_BOOT_SIGNATURE_TYPE_NONE=y
SB_CONFIG_MCUBOOT_MODE_DIRECT_XIP=y
```

## prj.conf
```kconfig
# factory — with MCUBoot (see sysbuild.conf + bootloader/).

CONFIG_PRINTK=y
CONFIG_CONSOLE=y
CONFIG_UART_CONSOLE=y
CONFIG_SERIAL=y
CONFIG_REBOOT=y
CONFIG_GPIO=y

# IRQ-backed console RX for factory cmd (uart_poll_in every 10ms drops multi-byte lines).
CONFIG_UART_INTERRUPT_DRIVEN=y
CONFIG_CONSOLE_SUBSYS=y
CONFIG_CONSOLE_GETCHAR=y
CONFIG_CONSOLE_GETCHAR_BUFSIZE=64

# Prefer repo common/log.h; Zephyr LOG off (symbol clash with common/src/log.c).
CONFIG_LOG=n

# TY rev_a: no external LFXO (DK default XTAL hangs before UART).
CONFIG_CLOCK_CONTROL_NRF_K32SRC_RC=y

CONFIG_FLASH=y
CONFIG_FLASH_MAP=y
CONFIG_CRC=y
CONFIG_NVS=y
CONFIG_SETTINGS=y
CONFIG_SETTINGS_NVS=y
CONFIG_MPU_ALLOW_FLASH_WRITE=y

# Factory pm_static: settings 8 KiB (rest of former 32 KiB gap → zboss_nvram).
CONFIG_PM_PARTITION_SIZE_SETTINGS_STORAGE=0x2000

CONFIG_APP_VERSION_STRING="0.0.0"
CONFIG_NRF54_NVS_DEFAULT_DEVICE_ID=0x0

CONFIG_HEAP_MEM_POOL_SIZE=2048
CONFIG_SYSTEM_WORKQUEUE_STACK_SIZE=2048
CONFIG_MAIN_STACK_SIZE=4096

# Zigbee: MPSL owns HFCLK — do not START_REQUEST_HFXO (deadlock risk).
CONFIG_START_REQUEST_HFXO=n

# --- Zigbee factory temp Coord / Router-DUT (single hex, soft-reset role) ---
CONFIG_ZIGBEE_ADD_ON=y
CONFIG_ZIGBEE_APP_UTILS=y
CONFIG_ZIGBEE_ROLE_COORDINATOR=y
CONFIG_ZIGBEE_CHANNEL_SELECTION_MODE_SINGLE=y
CONFIG_ZIGBEE_CHANNEL=15
CONFIG_ZIGBEE_ENABLE_TRACES=y
CONFIG_LTO=n
CONFIG_DK_LIBRARY=n
CONFIG_ZIGBEE_FACTORY_RESET=n
```

## src/main.c
```c
/*
 * projects/factory — thin Zephyr entry (kernel already running).
 */

#include "app.h"
#include "log.h"

int main(void)
{
	status_t st = app_startup();

	if (st != STATUS_OK)
	{
		LOG_ERROR("app_startup failed: %d", (int)st);
		return (int)st;
	}

	app_run();
	return 0;
}
```

## src/app.c
```c
/*
 * factory — project logic only (platform boot is in start/).
 * FTM 跳槽：board 配 BTN_PERMISSION_FTM；序列在 common button_ftm_seq_poll（start_poll）。
 */

#include "start.h"

#include <stdint.h>

#include <zephyr/kernel.h>
#include <zephyr/sys/printk.h>

#include "cmd.h"
#include "device_profile.h"
#include "flash_partition.h"
#include "log.h"
#include "nvs.h"
#include "zbft.h"

/** PC-based slot guess (swap-move images are primary-linked; see plan note). */
static uint8_t app_probe_slot(void)
{
	uintptr_t here = (uintptr_t)app_probe_slot;

	if ((here >= (uintptr_t)PART_APP_B_START) && (here < (uintptr_t)PART_APP_B_END)) {
		return 1U;
	}
	return 0U;
}

/*
 * 厂测按 did 分支初始化。新产品：在 nvs.h 加 NVS_PROJECT_ID_*，这里加 if 分支。
 * 例：if (did == NVS_PROJECT_ID_EINK_TAG) { 初始化对应外设 }
 */
static void factory_hw_init_eink_tag(void)
{
	/* stub */
}

static void factory_hw_init_demo(void)
{
	/* stub */
}

static void factory_hw_init_ink_panel(void)
{
	/* stub */
}

static void factory_hw_init_zigbee(void)
{
	/* stub */
}

static void factory_hw_init_default(void)
{
	/* stub */
}

static void factory_hw_init(void)
{
	uint32_t did = nvs_device_id_get();

	if (did == NVS_PROJECT_ID_EINK_TAG) {
		factory_hw_init_eink_tag();
	} else if (did == NVS_PROJECT_ID_DEMO) {
		factory_hw_init_demo();
	} else if (did == NVS_PROJECT_ID_INK_PANEL) {
		factory_hw_init_ink_panel();
	} else if ((did == NVS_PROJECT_ID_ZIGBEE_ED) ||
		   (did == NVS_PROJECT_ID_ZIGBEE_ROUTER)) {
		factory_hw_init_zigbee();
	} else {
		factory_hw_init_default();
	}
}

status_t app_init(void)
{
	uint8_t slot = app_probe_slot();
	uint8_t bmode = nvs_boot_mode_get();

	cmd_init(NULL, NULL);
	cmd_register_defaults();
	factory_hw_init();

	if (zbft_boot() != STATUS_OK) {
		LOG_WARN("zbft_boot failed");
	}

	LOG_INFO("factory app_init ok hw=%s slot=%u bmode=%u",
		 device_profile_hardware_name(device_profile_hardware_id()),
		 (unsigned)slot, (unsigned)bmode);
	printk("factory printk ok (uart20 P1.04/P1.05) slot=%u bmode=%u\n",
	       (unsigned)slot, (unsigned)bmode);
	return STATUS_OK;
}

void app_run(void)
{
	int64_t next_hb_ms = k_uptime_get() + 60000;

	LOG_INFO("factory app_run (type help; FTM seq in common)");

	while (1) {
		start_poll();
		cmd_poll();

		if (k_uptime_get() >= next_hb_ms) {
			LOG_INFO("factory heartbeat");
			next_hb_ms += 60000;
		}

		k_msleep(20);
	}
}
```

## src/app.h
```c
/*
 * Application lifecycle (Zephyr RTOS). Entry is main(); this file owns init order + run loop.
 */

#ifndef APP_H
#define APP_H

#ifdef __cplusplus
extern "C" {
#endif

#include "type.h"

/**
 * Synchronous bring-up: log → event → (lib hw) → cmd → threads.
 * Return STATUS_OK to enter app_run(); otherwise main logs and exits.
 */
status_t app_startup(void);

/**
 * Main-thread body after startup. Does not return under normal operation.
 */
void app_run(void);

#ifdef __cplusplus
}
#endif

#endif /* APP_H */
```
