## CMakeLists.txt
```
# SPDX-License-Identifier: Apache-2.0

cmake_minimum_required(VERSION 3.20.0)

# Shared: common + start (main / start_boot)
list(APPEND EXTRA_ZEPHYR_MODULES
  ${CMAKE_CURRENT_SOURCE_DIR}/../../modules/nrf54_common
  ${CMAKE_CURRENT_SOURCE_DIR}/../../modules/nrf54_start
)

# Per-project pinmux; before find_package(Zephyr)
set(DTC_OVERLAY_FILE ${CMAKE_CURRENT_SOURCE_DIR}/board/app.overlay)

find_package(Zephyr REQUIRED HINTS $ENV{ZEPHYR_BASE})
project(demo)

target_sources(app PRIVATE
  src/app.c
  board/board_config.c
)

# Per-app private libs live under lib/<module>/<module>.c — add explicitly when needed:
# target_sources(app PRIVATE lib/<module>/<module>.c)
# target_include_directories(app PRIVATE lib/<module>)
target_include_directories(app PRIVATE src)
```

## sysbuild.conf
```
# Sysbuild: MCUBoot (slot0=demo) + RISC-V FLPR remote.
# Factory image is programmed separately to slot1 (nrf.cmd -Project factory flash-slot1).

SB_CONFIG_BOOTLOADER_MCUBOOT=y
SB_CONFIG_BOOT_SIGNATURE_TYPE_NONE=y

SB_CONFIG_REMOTE_BOARD="nrf54l15dk/nrf54l15/cpuflpr"
```

## prj.conf
```kconfig
# Skeleton + TY board smoke: UART + dual LED + LFCLK RC + 外部 32M HFXO

CONFIG_PRINTK=y
CONFIG_CONSOLE=y
CONFIG_UART_CONSOLE=y
CONFIG_SERIAL=y
CONFIG_REBOOT=y
CONFIG_GPIO=y

# Prefer repo common/log.h macros; keep Zephyr LOG off to avoid macro clash if both included.
CONFIG_LOG=n

# 临时 EVT 冒烟：LF=RC；关 start 侧 HFXO（晶振未起会死等无灯）
CONFIG_CLOCK_CONTROL_NRF_K32SRC_RC=y
CONFIG_START_REQUEST_HFXO=n
CONFIG_SOC_NRF_FORCE_CONSTLAT=y

# Settings → settings_storage 32 KiB (+ boot_share 4 KiB in pm_static)
CONFIG_FLASH=y
CONFIG_FLASH_MAP=y
CONFIG_CRC=y
CONFIG_NVS=y
CONFIG_SETTINGS=y
CONFIG_SETTINGS_NVS=y
CONFIG_MPU_ALLOW_FLASH_WRITE=y
CONFIG_PM_PARTITION_SIZE_SETTINGS_STORAGE=0x8000

# Debug default; nrf.cmd release overrides via prj_version.conf
CONFIG_APP_VERSION_STRING="0.0.0"

# demo product_id = NVS_PROJECT_ID_DEMO (0x53530110)
CONFIG_NRF54_NVS_DEFAULT_DEVICE_ID=0x53530110
```

## src/main.c
```c
/*
 * projects/demo — thin Zephyr entry (kernel already running).
 */

#include "app.h"
#include "log.h"

int main(void)
{
	status_t st = app_startup();

	if (st != STATUS_OK)
	{
		LOG_ERROR("app_startup failed: %d", (int)st);
		return (int)st;
	}

	app_run();
	return 0;
}
```

## src/app.c
```c
/*
 * demo — project logic only (platform boot is in start/).
 * With MCUBoot: this image runs from slot0 (image-0); factory lives in slot1.
 * FTM 跳槽：board 配 BTN_PERMISSION_FTM；序列在 common button_ftm_seq_poll（start_poll）。
 */

#include "start.h"

#include <zephyr/kernel.h>
#include <zephyr/sys/printk.h>

#include "board.h"
#include "device_profile.h"
#include "log.h"
#include "nvs.h"

status_t app_init(void)
{
	uint8_t bmode = nvs_boot_mode_get();

	LOG_INFO("demo app_init ok hw=%s bmode=%u (expect slot0/image-0)",
		 device_profile_hardware_name(device_profile_hardware_id()),
		 (unsigned)bmode);
	printk("demo printk ok (uart00 EVT LED=P1.13) bmode=%u image-0\n",
	       (unsigned)bmode);
	/* nordic-flpr: cpuapp copies FLPR image to SRAM and starts RISC-V VPR */
	LOG_INFO("FLPR (RISC-V) co-processor enabled — see remote/ + uart30");
	return STATUS_OK;
}

void app_run(void)
{
	uint32_t tick = 0U;

	LOG_INFO("demo run (start_poll 20ms, heartbeat 1s; FTM seq in common)");

	while (1) {
		start_poll();
		if ((tick % 50U) == 0U) {
			LOG_INFO("demo heartbeat tick=%u board=%s core=cpuapp",
				 tick / 50U, board_config_get()->name);
		}
		tick++;
		k_sleep(K_MSEC(20));
	}
}
```
