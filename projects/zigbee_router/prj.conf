## CMakeLists.txt
```
# SPDX-License-Identifier: Apache-2.0

cmake_minimum_required(VERSION 3.20.0)

# Zigbee R23 add-on (ncs-zigbee). Set NCS_ZIGBEE_ROOT in nrf.env.
if(DEFINED ENV{NCS_ZIGBEE_ROOT} AND EXISTS "$ENV{NCS_ZIGBEE_ROOT}/zephyr/module.yml")
  list(APPEND EXTRA_ZEPHYR_MODULES "$ENV{NCS_ZIGBEE_ROOT}")
else()
  message(FATAL_ERROR
    "NCS_ZIGBEE_ROOT missing or invalid. Clone Zigbee R23 add-on, e.g.:\n"
    "  git clone --branch v1.4.0 https://github.com/nrfconnect/ncs-zigbee.git D:/ncs/tmp/ncs-zigbee\n"
    "  then set NCS_ZIGBEE_ROOT=D:/ncs/tmp/ncs-zigbee in nrf.env\n"
    "NOTE: add-on v1.4.0 targets NCS v3.4.x; this repo default is NCS v3.2.0 — see README.")
endif()

list(APPEND EXTRA_ZEPHYR_MODULES
  ${CMAKE_CURRENT_SOURCE_DIR}/../../modules/nrf54_common
  ${CMAKE_CURRENT_SOURCE_DIR}/../../modules/nrf54_start
)

set(DTC_OVERLAY_FILE ${CMAKE_CURRENT_SOURCE_DIR}/board/app.overlay)

find_package(Zephyr REQUIRED HINTS $ENV{ZEPHYR_BASE})
project(zigbee_router)

target_sources(app PRIVATE
  src/app.c
  board/board_config.c
  lib/zigbee/zigbee_app.c
  lib/zigbee/zboss_mem_globals.c
)

# LTO prebuilt ZBOSS: keep mem globals on classic ELF path (Nordic sample pattern).
set_source_files_properties(lib/zigbee/zboss_mem_globals.c PROPERTIES COMPILE_OPTIONS -fno-lto)

target_include_directories(app PRIVATE
  src
  lib/zigbee
)
```

## Kconfig
```
# Zigbee Router application options (sourced beside CMakeLists.txt).

config ZIGBEE_APP_TX_POWER
	int "Zigbee TX power (dBm)"
	range -40 8
	default 8
	help
	  Transmit power applied to each channel in CONFIG_ZIGBEE_CHANNEL_MASK
	  after zigbee_enable(). Session is compile-time only (not Settings).

menu "Zephyr Kernel"
source "Kconfig.zephyr"
endmenu
```

## sysbuild.conf
```
# MCUBoot swap-move (slot0=zigbee_router). Factory image → slot1 separately.
# No FLPR remote (unlike demo).

SB_CONFIG_PARTITION_MANAGER=y
SB_CONFIG_BOOTLOADER_MCUBOOT=y
SB_CONFIG_BOOT_SIGNATURE_TYPE_NONE=y
```

## prj.conf
```kconfig
# zigbee_router — Zigbee Router + OnOff Server（由 zigbee_ed 分出；无 BLE/EPD）
# Zigbee R23 add-on via NCS_ZIGBEE_ROOT；扫描掩码对齐 ZigBridge-EM M5

CONFIG_PRINTK=y
CONFIG_CONSOLE=y
CONFIG_UART_CONSOLE=y
CONFIG_SERIAL=y
CONFIG_UART_INTERRUPT_DRIVEN=y
CONFIG_REBOOT=y
CONFIG_GPIO=y

# 诊断：UART 无输出时用 J-Link RTT Viewer 看日志（与 UART console 可并存）
CONFIG_USE_SEGGER_RTT=y
CONFIG_RTT_CONSOLE=y

# Keep Zephyr LOG off so common/log.c log_init does not clash with log_core.c.
# Zigbee app_utils LOG_* become no-ops; app status uses common/log.h + printk.
CONFIG_LOG=n

CONFIG_CLOCK_CONTROL_NRF_K32SRC_RC=y
# Zigbee 启用 MPSL/802.15.4 后 HFCLK 由 MPSL 管；再手动 START_REQUEST_HFXO
# 会在 onoff_request 里与 MPSL 死等（PC 卡在 MPSL clock wait，无串口/无灯）。
# 联调勿开；与官方 light_bulb/template 一致，不额外要 HFXO。
CONFIG_START_REQUEST_HFXO=n

CONFIG_HEAP_MEM_POOL_SIZE=2048
CONFIG_SYSTEM_WORKQUEUE_STACK_SIZE=2048
CONFIG_MAIN_STACK_SIZE=4096

CONFIG_FLASH=y
CONFIG_FLASH_MAP=y
CONFIG_CRC=y
CONFIG_MPU_ALLOW_FLASH_WRITE=y

# Settings 8 KiB；其余原 32 KiB gap → zboss（见 pm_static.yml）
CONFIG_NVS=y
CONFIG_SETTINGS=y
CONFIG_SETTINGS_NVS=y
CONFIG_PM_PARTITION_SIZE_SETTINGS_STORAGE=0x2000

CONFIG_APP_VERSION_STRING="0.0.0"
# zigbee_router product_id = NVS_PROJECT_ID_ZIGBEE_ROUTER (0x53530150)
CONFIG_NRF54_NVS_DEFAULT_DEVICE_ID=0x53530150

# --- Zigbee Router（对齐官方 light_bulb）---
CONFIG_ZIGBEE_ADD_ON=y
CONFIG_ZIGBEE_APP_UTILS=y
CONFIG_ZIGBEE_ROLE_ROUTER=y
# Multi-channel scan: must cover gateway ZNP_CHANNEL_MASK_DEFAULT (11/15/20/25)
CONFIG_ZIGBEE_CHANNEL_SELECTION_MODE_MULTI=y
CONFIG_ZIGBEE_CHANNEL_MASK=0x02108800
# TX power (dBm) for mask channels; applied in lib/zigbee/zigbee_app.c
CONFIG_ZIGBEE_APP_TX_POWER=8

# ncs-zigbee v1.4 LTO prebuilts need GCC 14 (NCS 3.4). On NCS 3.2/GCC12 use
# trace (non-LTO) libs so link can succeed for bring-up.
CONFIG_ZIGBEE_ENABLE_TRACES=y
CONFIG_LTO=n

# No DK button lib; leave via app button + zb_bdb_reset_via_local_action
CONFIG_DK_LIBRARY=n
CONFIG_ZIGBEE_FACTORY_RESET=n
```

## src/app.c
```c
/*
 * zigbee_router — LED/按键 + Zigbee Router + OnOff Server；无 BLE/EPD。
 *
 * BTN1 短按 → 60s 配网窗 + Steering；BTN1 长按 ≈5s → boot_mode=factory 进厂测；
 * BTN2 双击 → leave；BTN2 长按 3s → 擦 ZBOSS NVRAM 并重启。
 * 网关 znp light → EP1 OnOff → 板载绿灯 + light: on|off
 */

#include "start.h"
#include "zigbee_app.h"

#include <zephyr/kernel.h>
#include <zephyr/sys/printk.h>
#include <zephyr/sys/reboot.h>

#include "app_event.h"
#include "board.h"
#include "button.h"
#include "device_profile.h"
#include "led_scene.h"
#include "log.h"
#include "nvs.h"

static zigbee_app_state_t s_zb_state = ZIGBEE_APP_STATE_IDLE;
static bool s_light_on;

static void app_zb_led_cancel_all(void)
{
	led_scene_cancel(LED_SCENE_ID_PAIRING);
	led_scene_cancel(LED_SCENE_ID_SUCCESS);
	led_scene_cancel(LED_SCENE_ID_ERROR);
	led_scene_cancel(LED_SCENE_ID_TRIGGER);
}

static void app_zb_led_apply(zigbee_app_state_t st)
{
	app_zb_led_cancel_all();

	switch (st) {
	case ZIGBEE_APP_STATE_STEERING:
	case ZIGBEE_APP_STATE_REJOINING:
		led_scene_run(LED_SCENE_ID_PAIRING);
		break;
	case ZIGBEE_APP_STATE_JOINED:
		led_scene_run(LED_SCENE_ID_SUCCESS);
		break;
	case ZIGBEE_APP_STATE_FAILED:
		led_scene_run(LED_SCENE_ID_ERROR);
		break;
	case ZIGBEE_APP_STATE_IDLE:
	default:
		led_scene_run(LED_SCENE_ID_TRIGGER);
		break;
	}
}

static void app_light_apply(bool on)
{
	s_light_on = on;
	app_zb_led_cancel_all();
	/* 控灯用绿灯（LED0）；灭时两灯都关 */
	led_scene_led_direct_set(LED_SCENE_LED_0, on);
	led_scene_led_direct_set(LED_SCENE_LED_1, false);
	LOG_INFO("light: %s", on ? "on" : "off");
	printk("light: %s\n", on ? "on" : "off");
}

static void app_zb_log_net(const zigbee_app_evt_t *evt)
{
	switch (evt->state) {
	case ZIGBEE_APP_STATE_STEERING:
		LOG_INFO("zigbee: steering");
		printk("zigbee: steering (mask=0x%08x ep=%d)\n",
		       CONFIG_ZIGBEE_CHANNEL_MASK, ZIGBEE_APP_ENDPOINT);
		break;
	case ZIGBEE_APP_STATE_REJOINING:
		LOG_INFO("zigbee: rejoining");
		printk("zigbee: rejoining (same-net)\n");
		break;
	case ZIGBEE_APP_STATE_JOINED:
		if (evt->ieee_valid) {
			/* 0x0000=协调器；Router 自身 parent 多为 coord */
			const char *parent_role =
				(evt->parent_nwk == 0x0000U) ? "coord" : "non-coord";

			LOG_INFO(
				"zigbee: joined nwk=0x%04x parent=0x%04x(%s) ieee=%02X%02X%02X%02X%02X%02X%02X%02X",
				evt->nwk_addr, evt->parent_nwk, parent_role, evt->ieee[7],
				evt->ieee[6], evt->ieee[5], evt->ieee[4], evt->ieee[3],
				evt->ieee[2], evt->ieee[1], evt->ieee[0]);
			printk("zigbee: joined nwk=0x%04x parent=0x%04x(%s) ieee=%02X%02X%02X%02X%02X%02X%02X%02X\n",
			       evt->nwk_addr, evt->parent_nwk, parent_role, evt->ieee[7],
			       evt->ieee[6], evt->ieee[5], evt->ieee[4], evt->ieee[3],
			       evt->ieee[2], evt->ieee[1], evt->ieee[0]);
		} else {
			LOG_INFO("zigbee: joined");
			printk("zigbee: joined\n");
		}
		break;
	case ZIGBEE_APP_STATE_FAILED:
		LOG_INFO("zigbee: failed");
		printk("zigbee: failed\n");
		break;
	case ZIGBEE_APP_STATE_IDLE:
	default:
		LOG_INFO("zigbee: idle / left");
		printk("zigbee: idle / left\n");
		break;
	}
}

static void app_handle_zigbee_evt(void)
{
	zigbee_app_evt_t evt;

	while (zigbee_app_evt_fetch(&evt)) {
		if (evt.kind == ZIGBEE_APP_EVT_LIGHT) {
			app_light_apply(evt.light_on);
			continue;
		}

		s_zb_state = evt.state;
		app_zb_log_net(&evt);
		app_zb_led_apply(evt.state);
		if (evt.state == ZIGBEE_APP_STATE_IDLE) {
			s_light_on = false;
		}
	}
}

static void app_handle_button(void)
{
	btn_id_e id;
	btn_event_e ev;

	if (!app_event_take(APP_EVT_BUTTON)) {
		return;
	}

	button_last_event_get(&id, &ev);
	button_last_event_clear();

	if ((id == BTN_ID_CONFIRM) && (ev == BTN_EVENT_SINGLE_CLICK)) {
		LOG_INFO("app: BTN1 short -> steer");
		zigbee_app_steer_request();
		return;
	}

	if ((id == BTN_ID_CONFIRM) && (ev == BTN_EVENT_LONG_PRESS)) {
		LOG_INFO("app: BTN1 long 5s -> boot_mode=factory");
		printk("app: BTN1 long -> factory reboot\n");
		if (!nvs_boot_mode_set(NVS_BOOT_MODE_FACTORY)) {
			LOG_ERROR("app: nvs_boot_mode_set(factory) failed");
			printk("app: factory boot_mode set fail\n");
			return;
		}
		k_msleep(50);
		sys_reboot(SYS_REBOOT_COLD);
		return;
	}

	if ((id == BTN_ID_BACK) && (ev == BTN_EVENT_DOUBLE_CLICK)) {
		LOG_INFO("app: BTN2 double -> leave");
		s_zb_state = ZIGBEE_APP_STATE_IDLE;
		s_light_on = false;
		app_zb_led_apply(ZIGBEE_APP_STATE_IDLE);
		zigbee_app_leave_request();
		return;
	}

	if ((id == BTN_ID_BACK) && (ev == BTN_EVENT_LONG_PRESS)) {
		LOG_INFO("app: BTN2 long 3s -> erase NVRAM + reboot");
		printk("app: BTN2 long -> erase NVRAM + reboot\n");
		zigbee_app_nv_erase_reboot_request();
	}
}

status_t app_init(void)
{
	uint8_t bmode = nvs_boot_mode_get();
	status_t st;

	/* 尽早打串口，便于确认已越过 start_boot / HFXO */
	printk("zigbee_router boot\n");

	/* BTN2 清 NV=3s；BTN1 进厂测=5s（勿给 BTN1 加 FTM permission，否则连击吞配网单击） */
	button_long_press_ms_set(3000U);
	button_long_press_ms_set_id(BTN_ID_CONFIRM, 5000U);

	LOG_INFO("zigbee_router app_init hw=%s bmode=%u mask=0x%08x ep=%d",
		 device_profile_hardware_name(device_profile_hardware_id()), (unsigned)bmode,
		 CONFIG_ZIGBEE_CHANNEL_MASK, ZIGBEE_APP_ENDPOINT);
	printk("zigbee_router ok mask=0x%08x ep=%d (BTN1=steer/long5s=ftm BTN2-dbl=leave BTN2-long3s=eraseNV)\n",
	       CONFIG_ZIGBEE_CHANNEL_MASK, ZIGBEE_APP_ENDPOINT);

	st = zigbee_app_start();
	if (st != STATUS_OK) {
		LOG_ERROR("zigbee_app_start failed st=%d", (int)st);
		return st;
	}

	s_light_on = false;
	app_zb_led_apply(ZIGBEE_APP_STATE_IDLE);
	return STATUS_OK;
}

void app_run(void)
{
	LOG_INFO("zigbee_router run (start_poll 20ms)");
	(void)s_zb_state;
	(void)s_light_on;

	while (1) {
		start_poll();
		app_handle_button();
		app_handle_zigbee_evt();
		k_sleep(K_MSEC(20));
	}
}
```
